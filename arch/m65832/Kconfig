## arch/m65832/Kconfig
```kconfig
# SPDX-License-Identifier: GPL-2.0
#
# M65832 Architecture Kconfig
#
# For a description of the syntax of this configuration file,
# see Documentation/kbuild/kconfig-language.rst.
#

config M65832
	def_bool y
	select ARCH_32BIT_OFF_T
	select ARCH_HAS_DMA_SET_UNCACHED
	select ARCH_HAS_SYNC_DMA_FOR_DEVICE
	select COMMON_CLK
	select GENERIC_ATOMIC64
	select GENERIC_CLOCKEVENTS
	select GENERIC_CPU_DEVICES
	select GENERIC_CSUM
	select GENERIC_HWEIGHT
	select GENERIC_IOREMAP
	select GENERIC_IRQ_CHIP
	select GENERIC_IRQ_MULTI_HANDLER
	select GENERIC_IRQ_PROBE
	select GENERIC_IRQ_SHOW
	select GENERIC_LIB_ASHLDI3
	select GENERIC_LIB_ASHRDI3
	select GENERIC_LIB_LSHRDI3
	select GENERIC_LIB_MULDI3
	select GENERIC_PCI_IOMAP
	select GENERIC_SCHED_CLOCK
	select GENERIC_SMP_IDLE_THREAD
	select GENERIC_TIME_VSYSCALL
	select HAVE_ARCH_TRACEHOOK
	select HAVE_MEMBLOCK
	select HAVE_REGS_AND_STACK_ACCESS_API
	select IRQ_DOMAIN
	select MODULES_USE_ELF_RELA
	select OF
	select OF_EARLY_FLATTREE
	select SET_FS
	select SPARSE_IRQ
	select STACKTRACE_SUPPORT
	select TRACE_IRQFLAGS_SUPPORT
	help
	  The M65832 is a 32-bit RISC processor based on the 6502/65816
	  instruction set architecture, extended with modern features
	  including a full MMU, supervisor/user modes, and atomic operations.

config CPU_LITTLE_ENDIAN
	def_bool y

config MMU
	def_bool y

config NO_IOPORT_MAP
	def_bool y

config LOCKDEP_SUPPORT
	def_bool y

config RWSEM_GENERIC_SPINLOCK
	def_bool y

config GENERIC_CALIBRATE_DELAY
	def_bool y

config GENERIC_BUG
	def_bool y

config FIX_EARLYCON_MEM
	def_bool y

config ZONE_DMA
	def_bool y

#
# Processor type and features
#
menu "Processor type and features"

choice
	prompt "Subarchitecture"
	default M65832_GENERIC

config M65832_GENERIC
	bool "Generic M65832"
	help
	  Generic M65832 architecture for emulator and FPGA targets.

endchoice

config M65832_FPU
	bool "FPU support"
	default y
	help
	  Enable hardware floating-point support. The M65832 FPU provides
	  16 64-bit floating-point registers (F0-F15) with IEEE 754
	  single and double precision support.

	  Say Y if your M65832 implementation includes the FPU.
	  Say N to use soft-float for all floating-point operations.

config NR_CPUS
	int
	default "1"

config CMDLINE
	string "Default kernel command string"
	default "console=ttyM65832,115200"
	help
	  On some systems the boot loader is unable to pass arguments to
	  the kernel. For such systems, you can supply command-line
	  options at build time by entering them here.

config CMDLINE_FORCE
	bool "Always use the default kernel command string"
	depends on CMDLINE != ""
	default n
	help
	  Always use the default kernel command string, ignoring any
	  command line passed by the boot loader.

source "kernel/Kconfig.hz"

endmenu

menu "Memory configuration"

config PAGE_OFFSET
	hex "Virtual address of kernel memory start"
	default 0x80000000
	help
	  This is the virtual address where kernel memory (low memory)
	  begins. Addresses below this are user space.

config PHYS_OFFSET
	hex "Physical address of RAM start"
	default 0x00000000
	help
	  This is the physical address where RAM begins on your system.

endmenu

menu "Platform options"

config M65832_TIMER_FREQ
	int "System timer frequency (Hz)"
	default 100000000
	help
	  The frequency of the M65832 system timer in Hz.
	  This should match your hardware configuration.

endmenu

menu "Debugging options"

config M65832_EARLY_PRINTK
	bool "Early printk support"
	default y
	help
	  Enable early console output before the normal console driver
	  is initialized. This is useful for debugging early boot issues.

config M65832_EARLYCON_UART_ADDRESS
	hex "Early console UART address"
	depends on M65832_EARLY_PRINTK
	default 0xFFFFF100
	help
	  Physical address of the UART for early console output.

endmenu
```

## arch/m65832/Kconfig.debug
```kconfig
# SPDX-License-Identifier: GPL-2.0
#
# M65832 Debugging Options
#

config EARLY_PRINTK
	bool "Early printk support"
	default y
	help
	  Say Y here to enable early_printk() output before the console
	  driver is initialized. This is useful for debugging boot problems.

config DEBUG_STACKOVERFLOW
	bool "Check for stack overflows"
	depends on DEBUG_KERNEL
	help
	  Check for stack overflow conditions during execution.

config DEBUG_STACK_USAGE
	bool "Stack utilization instrumentation"
	depends on DEBUG_KERNEL
	help
	  Track stack utilization for debugging purposes.
```

## arch/m65832/configs/defconfig
```kconfig
# M65832 Minimal Configuration
#
# This is a minimal configuration to get the kernel compiling.
# Many features are disabled for initial bring-up.

# Architecture
CONFIG_M65832=y
CONFIG_M65832_GENERIC=y
CONFIG_M65832_FPU=n

# General setup
CONFIG_LOCALVERSION="-m65832"
CONFIG_DEFAULT_HOSTNAME="m65832"
CONFIG_SYSVIPC=y
CONFIG_POSIX_MQUEUE=y
CONFIG_AUDIT=n
CONFIG_CGROUPS=n

# Memory
CONFIG_PAGE_OFFSET=0x80000000
CONFIG_PHYS_OFFSET=0x00000000
CONFIG_FLATMEM=y
CONFIG_FLAT_NODE_MEM_MAP=y

# Loadable module support
CONFIG_MODULES=n

# Block layer
CONFIG_BLOCK=y

# I/O Schedulers
CONFIG_MQ_IOSCHED_DEADLINE=y
CONFIG_MQ_IOSCHED_KYBER=n
CONFIG_IOSCHED_BFQ=n

# Processor type and features
CONFIG_HZ_100=y
CONFIG_HZ=100

# Executable file formats
CONFIG_BINFMT_ELF=y
CONFIG_BINFMT_SCRIPT=y

# Memory Management options
CONFIG_MMU=y
CONFIG_NEED_PAGE_INIT_CLEANUP=y

# Device Drivers
CONFIG_MTD=n
CONFIG_BLK_DEV=n
CONFIG_NETDEVICES=n
CONFIG_INPUT=n
CONFIG_VT=n
CONFIG_HW_RANDOM=n

# Character devices
CONFIG_SERIAL_EARLYCON=y
CONFIG_SERIAL_OF_PLATFORM=y

# File systems
CONFIG_EXT2_FS=n
CONFIG_EXT4_FS=n
CONFIG_PROC_FS=y
CONFIG_SYSFS=y
CONFIG_TMPFS=y
CONFIG_DEVTMPFS=y
CONFIG_DEVTMPFS_MOUNT=y

# Kernel hacking
CONFIG_PRINTK=y
CONFIG_BUG=y
CONFIG_DEBUG_KERNEL=y
CONFIG_DEBUG_INFO=n
CONFIG_FRAME_POINTER=y
CONFIG_M65832_EARLY_PRINTK=y

# Security options
CONFIG_SECURITY=n

# Library routines
CONFIG_BITREVERSE=y
CONFIG_GENERIC_FIND_FIRST_BIT=y
```
