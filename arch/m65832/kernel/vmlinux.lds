
OUTPUT_ARCH(m65832)
ENTRY(_start)
jiffies = jiffies_64;
SECTIONS
{
 . = 0x80000000;
 _text = .;
 .head.text : AT(ADDR(.head.text) - (0x80000000 - 0x00100000)) {
  _stext = .;
  KEEP(*(.head.text))
 }
 .text : AT(ADDR(.text) - (0x80000000 - 0x00100000)) {
  . = ALIGN(0); *(.text.asan.* .text.tsan.*) *(.text.unknown .text.unknown.*) __split_text_start = .; *(.text.split .text.split.[0-9a-zA-Z_]*) __split_text_end = .; __unlikely_text_start = .; *(.text.unlikely .text.unlikely.*) __unlikely_text_end = .; . = ALIGN((1 << 12)); __hot_text_start = .; *(.text.hot .text.hot.*) __hot_text_end = .; *(.text .text.[_0-9A-Za-df-rt-z]* .text.s[_0-9A-Za-su-z]* .text.s .text.s.* .text.st[_0-9A-Zb-z]* .text.st .text.st.* .text.sta[_0-9A-Za-qs-z]* .text.sta .text.sta.* .text.star[_0-9A-Za-su-z]* .text.star .text.star.* .text.start[_0-9A-Za-tv-z]* .text.start .text.start.* .text.startu[_0-9A-Za-oq-z]* .text.startu .text.startu.* .text.startup[_0-9A-Za-z]* .text.e[_0-9A-Za-wy-z]* .text.e .text.e.* .text.ex[_0-9A-Za-hj-z]* .text.ex .text.ex.* .text.exi[_0-9A-Za-su-z]* .text.exi .text.exi.* .text.exit[_0-9A-Za-z]* .text.fixup) . = ALIGN(0); __noinstr_text_start = .; *(.noinstr.text) __cpuidle_text_start = .; *(.cpuidle.text) __cpuidle_text_end = .; __noinstr_text_end = .; *(.ref.text)
  . = ALIGN(0); __sched_text_start = .; *(.sched.text) __sched_text_end = .;
  . = ALIGN(0); __lock_text_start = .; *(.spinlock.text) __lock_text_end = .;
  CPUIDLE_TEXT
  . = ALIGN(0); __kprobes_text_start = .; *(.kprobes.text) __kprobes_text_end = .;
  . = ALIGN(0); __irqentry_text_start = .; *(.irqentry.text) __irqentry_text_end = .;
  . = ALIGN(0); __softirqentry_text_start = .; *(.softirqentry.text) __softirqentry_text_end = .;
  *(.fixup)
  _etext = .;
 }
 . = ALIGN(4); __ex_table : AT(ADDR(__ex_table) - (0x80000000 - 0x00100000)) { __start___ex_table = .; KEEP(*(__ex_table)) __stop___ex_table = .; }
 . = ALIGN(4);
 __bug_table : AT(ADDR(__bug_table) - (0x80000000 - 0x00100000)) {
  __start___bug_table = .;
  KEEP(*(__bug_table))
  __stop___bug_table = .;
 }
 . = ALIGN(((1 << 12))); .rodata : AT(ADDR(.rodata) - (0x80000000 - 0x00100000)) { __start_rodata = .; *(.rodata) *(.rodata.*) *(.data.rel.ro*) . = ALIGN(32); __sched_class_highest = .; *(__stop_sched_class) *(__dl_sched_class) *(__rt_sched_class) *(__fair_sched_class) *(__ext_sched_class) *(__idle_sched_class) __sched_class_lowest = .; . = ALIGN(8); __start_ro_after_init = .; *(.data..ro_after_init) . = ALIGN(8); __start___jump_table = .; KEEP(*(__jump_table)) __stop___jump_table = .; __end_ro_after_init = .; . = ALIGN(8); __start___tracepoints_ptrs = .; KEEP(*(__tracepoints_ptrs)) __stop___tracepoints_ptrs = .; *(__tracepoints_strings) } .rodata1 : AT(ADDR(.rodata1) - (0x80000000 - 0x00100000)) { *(.rodata1) } .pci_fixup : AT(ADDR(.pci_fixup) - (0x80000000 - 0x00100000)) { __start_pci_fixups_early = .; KEEP(*(.pci_fixup_early)) __end_pci_fixups_early = .; __start_pci_fixups_header = .; KEEP(*(.pci_fixup_header)) __end_pci_fixups_header = .; __start_pci_fixups_final = .; KEEP(*(.pci_fixup_final)) __end_pci_fixups_final = .; __start_pci_fixups_enable = .; KEEP(*(.pci_fixup_enable)) __end_pci_fixups_enable = .; __start_pci_fixups_resume = .; KEEP(*(.pci_fixup_resume)) __end_pci_fixups_resume = .; __start_pci_fixups_suspend = .; KEEP(*(.pci_fixup_suspend)) __end_pci_fixups_suspend = .; __start_pci_fixups_resume_early = .; KEEP(*(.pci_fixup_resume_early)) __end_pci_fixups_resume_early = .; __start_pci_fixups_suspend_late = .; KEEP(*(.pci_fixup_suspend_late)) __end_pci_fixups_suspend_late = .; } .builtin_fw : AT(ADDR(.builtin_fw) - (0x80000000 - 0x00100000)) ALIGN(8) { __start_builtin_fw = .; KEEP(*(.builtin_fw)) __end_builtin_fw = .; } __ksymtab : AT(ADDR(__ksymtab) - (0x80000000 - 0x00100000)) { __start___ksymtab = .; KEEP(*(SORT(___ksymtab+*))) __stop___ksymtab = .; } __ksymtab_gpl : AT(ADDR(__ksymtab_gpl) - (0x80000000 - 0x00100000)) { __start___ksymtab_gpl = .; KEEP(*(SORT(___ksymtab_gpl+*))) __stop___ksymtab_gpl = .; } __kcrctab : AT(ADDR(__kcrctab) - (0x80000000 - 0x00100000)) { __start___kcrctab = .; KEEP(*(SORT(___kcrctab+*))) __stop___kcrctab = .; } __kcrctab_gpl : AT(ADDR(__kcrctab_gpl) - (0x80000000 - 0x00100000)) { __start___kcrctab_gpl = .; KEEP(*(SORT(___kcrctab_gpl+*))) __stop___kcrctab_gpl = .; } __ksymtab_strings : AT(ADDR(__ksymtab_strings) - (0x80000000 - 0x00100000)) { *(__ksymtab_strings) } __init_rodata : AT(ADDR(__init_rodata) - (0x80000000 - 0x00100000)) { *(.ref.rodata) } __param : AT(ADDR(__param) - (0x80000000 - 0x00100000)) { __start___param = .; KEEP(*(__param)) __stop___param = .; } __modver : AT(ADDR(__modver) - (0x80000000 - 0x00100000)) { __start___modver = .; KEEP(*(__modver)) __stop___modver = .; } /DISCARD/ : { *(.note.GNU-stack) *(.note.gnu.property) } .notes : AT(ADDR(.notes) - (0x80000000 - 0x00100000)) { __start_notes = .; KEEP(*(.note.*)) __stop_notes = .; } . = ALIGN(((1 << 12))); __end_rodata = .;
 . = ALIGN((1 << 12));
 __init_begin = .;
 . = ALIGN((1 << 12)); .init.text : AT(ADDR(.init.text) - (0x80000000 - 0x00100000)) { _sinittext = .; *(.init.text .init.text.*) *(.text.startup .text.startup.*) _einittext = .; }
 . = ALIGN(16);
 .init.data : AT(ADDR(.init.data) - (0x80000000 - 0x00100000)) {
  KEEP(*(SORT(___kentry+*))) *(.init.data .init.data.*) *(.init.rodata .init.rodata.*) . = ALIGN(8); __clk_of_table = .; KEEP(*(__clk_of_table)) KEEP(*(__clk_of_table_end)) . = ALIGN(8); __reservedmem_of_table = .; KEEP(*(__reservedmem_of_table)) KEEP(*(__reservedmem_of_table_end)) . = ALIGN(32); __dtb_start = .; KEEP(*(.dtb.init.rodata)) __dtb_end = .; . = ALIGN(8); __irqchip_of_table = .; KEEP(*(__irqchip_of_table)) KEEP(*(__irqchip_of_table_end)) . = ALIGN(8); __earlycon_table = .; KEEP(*(__earlycon_table)) __earlycon_table_end = .; . = ALIGN(8); __kunit_init_suites_start = .; KEEP(*(.kunit_init_test_suites)) __kunit_init_suites_end = .;
 }
 . = ALIGN(4);
 .init.setup : AT(ADDR(.init.setup) - (0x80000000 - 0x00100000)) {
  __setup_start = .;
  KEEP(*(.init.setup))
  __setup_end = .;
 }
 .initcall.init : AT(ADDR(.initcall.init) - (0x80000000 - 0x00100000)) {
  __initcall_start = .;
  __initcall_start = .; KEEP(*(.initcallearly.init)) __initcall0_start = .; KEEP(*(.initcall0.init)) KEEP(*(.initcall0s.init)) __initcall1_start = .; KEEP(*(.initcall1.init)) KEEP(*(.initcall1s.init)) __initcall2_start = .; KEEP(*(.initcall2.init)) KEEP(*(.initcall2s.init)) __initcall3_start = .; KEEP(*(.initcall3.init)) KEEP(*(.initcall3s.init)) __initcall4_start = .; KEEP(*(.initcall4.init)) KEEP(*(.initcall4s.init)) __initcall5_start = .; KEEP(*(.initcall5.init)) KEEP(*(.initcall5s.init)) __initcallrootfs_start = .; KEEP(*(.initcallrootfs.init)) KEEP(*(.initcallrootfss.init)) __initcall6_start = .; KEEP(*(.initcall6.init)) KEEP(*(.initcall6s.init)) __initcall7_start = .; KEEP(*(.initcall7.init)) KEEP(*(.initcall7s.init)) __initcall_end = .;
  __initcall_end = .;
 }
 .con_initcall.init : AT(ADDR(.con_initcall.init) - (0x80000000 - 0x00100000)) {
  __con_initcall_start = .;
  KEEP(*(.con_initcall.init))
  __con_initcall_end = .;
 }
 . = ALIGN((1 << 12));
 __init_end = .;
 _sdata = .;
 . = ALIGN((1 << 12));
 .data : AT(ADDR(.data) - (0x80000000 - 0x00100000)) {
  . = ALIGN(((1 << 12) << 4)); __start_init_stack = .; init_thread_union = .; init_stack = .; KEEP(*(.data..init_thread_info)) . = __start_init_stack + ((1 << 12) << 4); __end_init_stack = .;
  *(.xiptext) *(.data .data.[0-9a-zA-Z_]* .data.rel.* .data..L* .data..compoundliteral* .data.$__unnamed_* .data.$L*) *(.data..decrypted) *(.ref.data) *(.data..shared_aligned) *(.data..unlikely) __start_once = .; *(.data..once) __end_once = .; *(.data..do_once) . = ALIGN(32); *(__tracepoints) . = ALIGN(8); __start___dyndbg_classes = .; KEEP(*(__dyndbg_classes)) __stop___dyndbg_classes = .; __start___dyndbg = .; KEEP(*(__dyndbg)) __stop___dyndbg = .; . = ALIGN(8); __kunit_suites_start = .; KEEP(*(.kunit_test_suites)) __kunit_suites_end = .;
  CONSTRUCTORS
 }
 . = ALIGN(4);
 .data.cacheline_aligned : AT(ADDR(.data.cacheline_aligned) - (0x80000000 - 0x00100000)) {
  *(.data.cacheline_aligned)
 }
 _edata = .;
 . = ALIGN(4); __bss_start = .; . = ALIGN(4); .sbss : AT(ADDR(.sbss) - (0x80000000 - 0x00100000)) { *(.dynsbss) *(.sbss .sbss.[0-9a-zA-Z_]*) *(.scommon) } . = ALIGN(4); .bss : AT(ADDR(.bss) - (0x80000000 - 0x00100000)) { . = ALIGN((1 << 12)); *(.bss..page_aligned) . = ALIGN((1 << 12)); *(.dynbss) *(.bss .bss.[0-9a-zA-Z_]* .bss..L* .bss..compoundliteral*) *(COMMON) } . = ALIGN(4); __bss_stop = .;
 _end = .;
 .vectors : AT(ADDR(.vectors) - (0x80000000 - 0x00100000)) {
  __vectors_start = .;
  KEEP(*(.vectors))
  __vectors_end = .;
 }
 .stab 0 : { *(.stab) } .stabstr 0 : { *(.stabstr) } .stab.excl 0 : { *(.stab.excl) } .stab.exclstr 0 : { *(.stab.exclstr) } .stab.index 0 : { *(.stab.index) } .stab.indexstr 0 : { *(.stab.indexstr) }
 .debug 0 : { *(.debug) } .line 0 : { *(.line) } .debug_srcinfo 0 : { *(.debug_srcinfo) } .debug_sfnames 0 : { *(.debug_sfnames) } .debug_aranges 0 : { *(.debug_aranges) } .debug_pubnames 0 : { *(.debug_pubnames) } .debug_info 0 : { *(.debug_info .gnu.linkonce.wi.*) } .debug_abbrev 0 : { *(.debug_abbrev) } .debug_line 0 : { *(.debug_line) } .debug_frame 0 : { *(.debug_frame) } .debug_str 0 : { *(.debug_str) } .debug_loc 0 : { *(.debug_loc) } .debug_macinfo 0 : { *(.debug_macinfo) } .debug_pubtypes 0 : { *(.debug_pubtypes) } .debug_ranges 0 : { *(.debug_ranges) } .debug_weaknames 0 : { *(.debug_weaknames) } .debug_funcnames 0 : { *(.debug_funcnames) } .debug_typenames 0 : { *(.debug_typenames) } .debug_varnames 0 : { *(.debug_varnames) } .debug_gnu_pubnames 0 : { *(.debug_gnu_pubnames) } .debug_gnu_pubtypes 0 : { *(.debug_gnu_pubtypes) } .debug_types 0 : { *(.debug_types) } .debug_addr 0 : { *(.debug_addr) } .debug_line_str 0 : { *(.debug_line_str) } .debug_loclists 0 : { *(.debug_loclists) } .debug_macro 0 : { *(.debug_macro) } .debug_names 0 : { *(.debug_names) } .debug_rnglists 0 : { *(.debug_rnglists) } .debug_str_offsets 0 : { *(.debug_str_offsets) }
 /DISCARD/ : { *(.exit.text) *(.text.exit .text.exit.*) *(.exit.data .exit.data.*) *(.fini_array .fini_array.*) *(.dtors .dtors.*) *(.exitcall.exit) *(.discard) *(.discard.*) *(.export_symbol) *(.no_trim_symbol) *(.gnu.version*) *(__tracepoint_check) }
}
